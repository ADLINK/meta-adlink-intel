## conf/layer.conf
```bitbake
# We have a conf and classes directory, add to BBPATH
BBPATH .= ":${LAYERDIR}"

# We have recipes-* directories, add to BBFILES
BBFILES += "${LAYERDIR}/recipes-*/*/*.bb \
            ${LAYERDIR}/recipes-*/*/*.bbappend"

BBFILE_COLLECTIONS += "meta-adlink-intel"
BBFILE_PATTERN_meta-adlink-intel := "^${LAYERDIR}/"

# Additional license directories.
#LICENSE_PATH += "${LAYERDIR}/custom-licenses"

LAYERDEPENDS_meta-adlink-intel = "intel adlink-demo"
LAYERRECOMMENDS_meta-adlink-intel = "dpdk intel-qat"

# This should only be incremented on significant changes that will
# cause compatibility issues with other layers
LAYERVERSION_meta-adlink-intel = "6"
LAYERSERIES_COMPAT_meta-adlink-intel = "zeus dunfell hardknott"
```
